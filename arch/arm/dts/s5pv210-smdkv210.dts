/*
 * Samsung's Exynos4210-based SMDKV310 board device tree source
 *
 * Copyright (c) 2014 Google, Inc
 *
 * SPDX-License-Identifier:	GPL-2.0+
 */

/dts-v1/;

#include "skeleton.dtsi"
#include "s5pc100-pinctrl.dtsi"

/ {
	model = "Samsung SMDKV210 based on S5PV210";
	compatible = "samsung,smdkv210", "samsung,s5pv210";

	aliases {
		serial0 = "/serial@e2900000";
		console = "/serial@e2900000";
		pinctrl0 = &pinctrl0;
	};

	pinctrl0: pinctrl@e0200000 {
		compatible = "samsung,s5pc100-pinctrl";
		reg = <0xe0200000 0x1000>;
	};

	serial@e2900000 {
		compatible = "samsung,exynos4210-uart";
		reg = <0xe2900000 0x400>;
		id = <0>;
	};

};
