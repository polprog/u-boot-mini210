## arch/arm/mach-s5pv210/Kconfig
```kconfig
if ARCH_S5PV210

choice
	prompt "S5PV210 board select"
	optional

#config TARGET_S5P_GONI
#	bool "S5P Goni board"
#	select OF_CONTROL

config TARGET_SMDKV210
	bool "Support smdkv210 board"
	select OF_CONTROL

config TARGET_MINI210
	bool "Support FriendlyArm mini210 board"
	select OF_CONTROL


endchoice

config SYS_SOC
	default "s5pv210"

source "board/samsung/goni/Kconfig"
source "board/samsung/smdkv210/Kconfig"
source "board/friendlyarm/mini210/Kconfig"

endif
```

## board/friendlyarm/mini210/Kconfig
```kconfig
if TARGET_MINI210

config SYS_BOARD
	default "mini210"

config SYS_VENDOR
	default "friendlyarm"

config SYS_SOC
	default "s5pv210"

config SYS_CONFIG_NAME
	default "mini210"

endif
```

## board/samsung/smdkv210/Kconfig
```kconfig
if TARGET_SMDKV210

config SYS_BOARD
	default "smdkv210"

config SYS_VENDOR
	default "samsung"

config SYS_SOC
	default "s5pv210"

config SYS_CONFIG_NAME
	default "smdkv210"

endif
```

## configs/mini210_defconfig
```kconfig
CONFIG_ARM=y
CONFIG_ARCH_S5PV210=y
CONFIG_TARGET_MINI210=y
CONFIG_IDENT_STRING=" for mini210"
CONFIG_DEFAULT_DEVICE_TREE="s5pv210-smdkv210"
CONFIG_BOOTDELAY=3
CONFIG_HUSH_PARSER=y
CONFIG_SYS_PROMPT="mini210 # "
# CONFIG_CMD_IMLS is not set
# CONFIG_CMD_FLASH is not set
# CONFIG_CMD_SETEXPR is not set
CONFIG_CMD_CACHE=y
CONFIG_CMD_FAT=y

# add by Sourcelink
CONFIG_SPL=y
```
